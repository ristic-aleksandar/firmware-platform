## components/e32p_sysinfo/Kconfig
```kconfig
menu "e32p: sysinfo"

    config E32P_SYSINFO_ENABLE
        bool "Enable e32p_sysinfo (system introspection)"
        default n
        help
            Read-only helpers for chip / app identity, reset reason, uptime, and
            heap stats, plus a one-call boot summary log. No init required.

endmenu
```

## components/e32p_tm1637/Kconfig
```kconfig
menu "e32p: tm1637"

    config E32P_TM1637_ENABLE
        bool "Enable e32p_tm1637 (TM1637 4-digit 7-segment display)"
        select E32P_GPIO_ENABLE
        default n
        help
            Driver for TM1637-based 4-digit 7-segment displays (clock modules with
            a colon). The 7-segment font and integer formatting are pure functions
            (unit-testable headless); the transport bit-bangs the TM1637's I2C-like
            2-wire protocol (start/stop + per-byte ACK, LSB-first, no address) over
            two open-drain GPIOs. Selecting this pulls in e32p_gpio.

endmenu
```

## components/e32p_touch/Kconfig
```kconfig
menu "e32p: touch"

    config E32P_TOUCH_ENABLE
        bool "Enable e32p_touch (capacitive touch)"
        depends on SOC_TOUCH_SENSOR_SUPPORTED
        default n
        help
            Facade over the ESP32 touch sensor: init, configure a pad, and read
            its raw capacitance value. Hidden on SoCs without a touch sensor
            (e.g. ESP32-C3).

endmenu
```

## components/e32p_twai/Kconfig
```kconfig
menu "e32p: twai"

    config E32P_TWAI_ENABLE
        bool "Enable e32p_twai (CAN 2.0 / TWAI)"
        depends on SOC_TWAI_SUPPORTED
        default n
        help
            Facade over the ESP-IDF TWAI (CAN 2.0) controller: install, start,
            transmit and receive frames. A real bus needs an external transceiver;
            NO_ACK mode + a self frame allows a jumper-only loopback test.

    config E32P_TWAI_RX_QUEUE_LEN
        int "TWAI driver RX queue depth (frames)"
        depends on E32P_TWAI_ENABLE
        range 5 64
        default 5
        help
            How many received frames the driver buffers before dropping. The
            IDF default is 5, which is ~2.5 ms of wire time at 250 kbit but only
            ~0.6 ms at 1 Mbit - too little if a higher-priority task preempts
            mid-burst. Raise it for high bitrates or bursty multi-frame
            transports such as ISO-TP. Costs sizeof(twai_message_t) (~16 B) per
            slot.

    config E32P_TWAI_TX_QUEUE_LEN
        int "TWAI driver TX queue depth (frames)"
        depends on E32P_TWAI_ENABLE
        range 5 64
        default 5
        help
            How many frames may be queued for transmission. This bounds burst
            throughput: a sender that refills the queue once per poll tick moves
            at most this many frames per tick, so a shallow queue caps a
            segmented transport regardless of bitrate. Raise it alongside the RX
            depth when running ISO-TP at 500 kbit or 1 Mbit.

            NOTE: a deeper TX queue means more frames may still be in flight
            when you stop the controller. Drain with twai_get_status_info()
            .msgs_to_tx before twai_stop(), or the tail of a transfer is aborted.

endmenu
```

## components/e32p_uart/Kconfig
```kconfig
menu "e32p: uart"

    config E32P_UART_ENABLE
        bool "Enable e32p_uart (UART port facade)"
        default n
        help
            Opaque-handle wrapper over the ESP-IDF UART driver: one handle per
            port, blocking write / timed read, RX buffering, and an internal
            loopback mode for self-test without wiring.

endmenu
```

## components/e32p_uds/Kconfig
```kconfig
menu "e32p: uds"

    config E32P_UDS_ENABLE
        bool "Enable e32p_uds (ISO 14229-1 UDS server)"
        depends on SOC_TWAI_SUPPORTED
        select E32P_ISOTP_ENABLE
        default n
        help
            A UDS server over ISO-TP: diagnostic sessions with the S3 timeout,
            security access with a lockout, data identifiers, trouble codes,
            routines, and a download path that can reflash the device.

            The server is pure - requests in, responses out through a callback,
            time injected through poll() - so every timing rule, including the
            0x78 responsePending cadence, is testable headless. Only the thin
            transport glue touches ISO-TP.

endmenu
```

## components/e32p_wdt/Kconfig
```kconfig
menu "e32p: wdt"

    config E32P_WDT_ENABLE
        bool "Enable e32p_wdt (task watchdog)"
        default n
        help
            Facade over the ESP-IDF Task Watchdog Timer: configure timeout/panic,
            subscribe the current task, and feed it. Idempotent init that adopts
            a system-started TWDT via reconfigure.

endmenu
```

## components/e32p_ws2812/Kconfig
```kconfig
menu "e32p: ws2812"

    config E32P_WS2812_ENABLE
        bool "Enable e32p_ws2812 (WS2812/NeoPixel over RMT)"
        depends on SOC_RMT_SUPPORTED
        default n
        help
            Addressable-LED driver for WS2812/NeoPixel strips, built on the
            ESP-IDF v5.x RMT TX driver with a composite (bytes + copy) encoder.
            Stage pixel colors in a buffer, then refresh() clocks the strip.
            Works on a bare board (the RMT engine still clocks the frame out);
            a connected strip is needed to see light.

endmenu
```

## examples/12_wifi_sta/main/Kconfig.projbuild
```kconfig
menu "Example Wi-Fi Configuration"

    config E32P_EXAMPLE_WIFI_SSID
        string "WiFi SSID"
        default "myssid"
        help
            SSID (network name) for the example to connect to.

    config E32P_EXAMPLE_WIFI_PASSWORD
        string "WiFi Password"
        default "mypassword"
        help
            WiFi passphrase. Leave empty for an open network.

endmenu
```
