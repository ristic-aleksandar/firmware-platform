## _template/Kconfig
```kconfig
menu "e32p: foo (TEMPLATE)"

    config E32P_FOO_ENABLE
        bool "Enable e32p_foo (template)"
        default n
        help
            Example enable switch. Copy this file when creating a new module and
            rename FOO/foo to your module name. Add `depends on SOC_<FEATURE>_SUPPORTED`
            for chip-specific peripherals so disabled targets hide the option.

endmenu
```

## components/e32p_adc/Kconfig
```kconfig
menu "e32p: adc"

    config E32P_ADC_ENABLE
        bool "Enable e32p_adc (oneshot ADC)"
        default n
        help
            Oneshot ADC facade with per-channel attenuation and optional
            line-fitting calibration to millivolts. One handle per ADC unit.
            Note: ADC2 cannot be read while Wi-Fi is active.

endmenu
```

## components/e32p_ble/Kconfig
```kconfig
menu "e32p: ble"

    config E32P_BLE_ENABLE
        bool "Enable e32p_ble (BLE GATT peripheral over NimBLE)"
        default n
        help
            BLE peripheral facade: advertise a named device with one custom
            service and characteristics (read/write/notify). The advertising
            payload assembly and UUID helpers are pure and unit-tested headless.
            The radio path is compiled only when the NimBLE host is enabled
            (Component config -> Bluetooth -> Bluetooth enabled + Host = NimBLE,
            i.e. CONFIG_BT_NIMBLE_ENABLED). Without it, the device functions return
            ESP_ERR_NOT_SUPPORTED so the module still builds in radio-free targets.

endmenu
```

## components/e32p_bmp280/Kconfig
```kconfig
menu "e32p: bmp280"

    config E32P_BMP280_ENABLE
        bool "Enable e32p_bmp280 (Bosch BMP280 pressure/temperature sensor)"
        select E32P_I2C_ENABLE
        default n
        help
            Driver for the Bosch BMP280 pressure + temperature sensor over
            e32p_i2c. The Bosch compensation math (datasheet §3.11.3) is kept as
            pure functions so it is unit-testable headless against the datasheet
            reference vector; the thin I2C layer probes the chip id, reads the
            factory calibration, applies oversampling/filter/mode, and burst-reads
            samples. Selecting this pulls in e32p_i2c.

endmenu
```

## components/e32p_dac/Kconfig
```kconfig
menu "e32p: dac"

    config E32P_DAC_ENABLE
        bool "Enable e32p_dac (8-bit DAC output)"
        depends on SOC_DAC_SUPPORTED
        default n
        help
            Oneshot 8-bit DAC output on ESP32 channels ch0 (GPIO25) / ch1
            (GPIO26). Hidden on targets without a DAC (S2 has it; S3/C3/C6 do not).

endmenu
```

## components/e32p_event/Kconfig
```kconfig
menu "e32p: event"

    config E32P_EVENT_ENABLE
        bool "Enable e32p_event (default event loop)"
        default n
        help
            Singleton wrapper over the ESP-IDF default event loop: idempotent
            init/deinit plus register / unregister / post helpers. Required by
            Wi-Fi and most connectivity modules.

endmenu
```

## components/e32p_gpio/Kconfig
```kconfig
menu "e32p: gpio"

    config E32P_GPIO_ENABLE
        bool "Enable e32p_gpio (digital I/O facade)"
        default n
        help
            Thin per-pin wrapper over the ESP-IDF GPIO driver with WROOM-32
            pin-safety guards. Pin guards themselves are controlled by
            E32P_PIN_GUARDS in the e32p_core menu.

endmenu
```

## components/e32p_gptimer/Kconfig
```kconfig
menu "e32p: gptimer"

    config E32P_GPTIMER_ENABLE
        bool "Enable e32p_gptimer (general-purpose timer)"
        default n
        help
            Facade over the ESP-IDF general-purpose hardware timer: a periodic or
            one-shot alarm with an ISR callback, plus raw count read. One handle
            per timer.

endmenu
```

## components/e32p_i2c/Kconfig
```kconfig
menu "e32p: i2c"

    config E32P_I2C_ENABLE
        bool "Enable e32p_i2c (I2C master facade)"
        default n
        help
            Bus + device facade over the ESP-IDF v5.x i2c_master driver: create a
            bus, probe / scan for devices, attach devices, and do byte / register
            transfers. Requires the new driver (not the legacy driver/i2c.h).

endmenu
```

## components/e32p_i2s/Kconfig
```kconfig
menu "e32p: i2s"

    config E32P_I2S_ENABLE
        bool "Enable e32p_i2s (I2S standard-mode audio)"
        depends on SOC_I2S_SUPPORTED
        default n
        help
            Facade over the ESP-IDF v5.x I2S standard (Philips) mode: one channel
            per handle, TX (playback) or RX (capture), with PCM read/write. Needs
            an external I2S DAC (playback) or mic (capture).

endmenu
```

## components/e32p_isotp/Kconfig
```kconfig
menu "e32p: isotp"

    config E32P_ISOTP_ENABLE
        bool "Enable e32p_isotp (ISO 15765-2 transport)"
        depends on SOC_TWAI_SUPPORTED
        select E32P_TWAI_ENABLE
        default n
        help
            ISO 15765-2 (ISO-TP) segmentation over classic CAN: SF / FF / CF /
            FC, payloads up to 4095 bytes. This is the transport OBD-II and UDS
            run on. It is NOT SAE J1939-21 TP (see e32p_j1939tp) - a different
            segmentation scheme with different addressing.

            The engine is driven by an injected frame sink plus a periodic
            poll(now_ms) tick, so it runs headless and is fully unit-testable.

    # ---- Bench defaults -----------------------------------------------------
    # Consumed by examples and the HIL agent when they bring the bus up and build
    # an e32p_isotp_config_t. The ENGINE reads neither choice - everything it
    # uses comes from e32p_isotp_config_t at runtime.

    choice E32P_ISOTP_BITRATE
        prompt "Default CAN bitrate for ISO-TP apps"
        depends on E32P_ISOTP_ENABLE
        default E32P_ISOTP_BITRATE_250K
        help
            The bitrate an app passes to e32p_twai_init(). A CAN bus is a
            single-bitrate domain: EVERY node must match, including a CANable
            sniffer. Changing this needs a rebuild and a reflash of every node.

        config E32P_ISOTP_BITRATE_250K
            bool "250 kbit/s  (this bench's J1939 default - both suites in one session)"
        config E32P_ISOTP_BITRATE_500K
            bool "500 kbit/s  (typical OBD-II / ISO 15765-4)"
        config E32P_ISOTP_BITRATE_1M
            bool "1 Mbit/s    (raise E32P_TWAI_RX_QUEUE_LEN/TX_QUEUE_LEN with it)"
    endchoice

    config E32P_ISOTP_BITRATE_BPS
        int
        depends on E32P_ISOTP_ENABLE
        default 250000  if E32P_ISOTP_BITRATE_250K
        default 500000  if E32P_ISOTP_BITRATE_500K
        default 1000000 if E32P_ISOTP_BITRATE_1M

    choice E32P_ISOTP_ADDRESSING
        prompt "Default ISO-TP addressing"
        depends on E32P_ISOTP_ENABLE
        default E32P_ISOTP_ADDRESSING_NORMAL_11
        help
            Normal 11-bit is the ISO 15765-4 baseline (0x7E0/0x7E8). Normal fixed
            is the 29-bit form, 0x18DA{TA}{SA} physical / 0x18DB{TA}{SA}
            functional, which coexists with J1939 on one bus - SAE J1939-73
            reserves PGN 55808 (0xDA00) for exactly this.

        config E32P_ISOTP_ADDRESSING_NORMAL_11
            bool "Normal, 11-bit"
        config E32P_ISOTP_ADDRESSING_NORMAL_FIXED
            bool "Normal fixed, 29-bit"
    endchoice

    # ---- Engine tunables ----------------------------------------------------

    config E32P_ISOTP_MAX_MSG_BYTES
        int "Max ISO-TP payload (bytes)"
        depends on E32P_ISOTP_ENABLE
        range 8 4095
        default 1024
        help
            Bounds BOTH buffers of every channel: RAM = 2 x this per channel.
            1024 matches the reference deployment; example 31 overrides it
            per-instance to 4095 to demonstrate the spec maximum.

    config E32P_ISOTP_MAX_CHANNELS
        int "Channels the TWAI link can route to"
        depends on E32P_ISOTP_ENABLE
        range 1 8
        default 4
        help
            Upper bound on channels attached to the single TWAI peripheral.
            An OBD-II server needs two (functional 0x7DF + physical 0x7E0).

endmenu
```

## components/e32p_j1939/Kconfig
```kconfig
menu "e32p: j1939"

    config E32P_J1939_ENABLE
        bool "Enable e32p_j1939 (SAE J1939 protocol layer)"
        depends on SOC_TWAI_SUPPORTED
        select E32P_TWAI_ENABLE
        default n
        help
            SAE J1939 protocol/data layer over e32p_twai: 29-bit CAN ID <-> PGN
            codec (PDU1/PDU2), source/destination addressing, and single-frame
            (<=8 byte) send/receive. The application configures and starts TWAI;
            this layer adds the J1939 node address and message framing. Transport
            (>8 byte messages) is provided by e32p_j1939tp. Selecting this pulls
            in e32p_twai.

endmenu
```

## components/e32p_j1939_acl/Kconfig
```kconfig
menu "e32p: j1939_acl"

    config E32P_J1939_ACL_ENABLE
        bool "Enable e32p_j1939_acl (J1939-81 address claiming)"
        depends on SOC_TWAI_SUPPORTED
        select E32P_J1939_ENABLE
        default n
        help
            SAE J1939-81 address claiming over e32p_j1939: pack/unpack the 64-bit
            NAME, claim a source address, defend it by NAME arbitration (lower
            NAME wins), answer Requests for Address Claimed, and on a lost claim
            relocate (if arbitrary-address-capable) or report Cannot Claim. Same
            injected-sink + poll(now_ms) design as e32p_j1939tp, so it runs
            headless and is fully unit-testable. Selecting this pulls in
            e32p_j1939 (and TWAI).

endmenu
```

## components/e32p_j1939tp/Kconfig
```kconfig
menu "e32p: j1939tp"

    config E32P_J1939TP_ENABLE
        bool "Enable e32p_j1939tp (J1939-21 Transport Protocol)"
        depends on SOC_TWAI_SUPPORTED
        select E32P_J1939_ENABLE
        default n
        help
            J1939-21 Transport Protocol over e32p_j1939: segments and reassembles
            9..1785 byte messages via BAM (broadcast) and RTS/CTS (connection
            mode), transmit and receive. The engine is driven by an injected
            frame sink plus a periodic poll(now_ms) tick, so it runs headless and
            is fully unit-testable. Selecting this pulls in e32p_j1939 (and TWAI).

    config E32P_J1939TP_MAX_MSG_BYTES
        int "Max multi-packet message size (bytes)"
        depends on E32P_J1939TP_ENABLE
        range 9 1785
        default 1785
        help
            Bounds each session buffer (one TX + N RX). Lower it to save RAM if
            your application never transfers large messages.

    config E32P_J1939TP_MAX_RX_SESSIONS
        int "Concurrent inbound TP sessions"
        depends on E32P_J1939TP_ENABLE
        range 1 8
        default 2
        help
            Number of simultaneous inbound transfers (keyed by source address).

endmenu
```

## components/e32p_ledc/Kconfig
```kconfig
menu "e32p: ledc"

    config E32P_LEDC_ENABLE
        bool "Enable e32p_ledc (PWM facade)"
        depends on SOC_LEDC_SUPPORTED
        default n
        help
            Opaque-handle wrapper over the ESP-IDF LEDC driver: one handle per
            PWM channel, with duty control and hardware fade. Hidden on targets
            that have no LEDC peripheral.

endmenu
```

## components/e32p_modbus/Kconfig
```kconfig
menu "e32p: modbus"

    config E32P_MODBUS_ENABLE
        bool "Enable e32p_modbus (Modbus RTU master + protocol core)"
        select E32P_UART_ENABLE
        default n
        help
            Modbus RTU master over e32p_uart with the common function codes (0x03
            read holding, 0x04 read input, 0x06 write single, 0x10 write multiple).
            The protocol core (CRC-16/Modbus, ADU framing, request build, response
            parse) and a pure slave request handler are unit-tested headless — a
            full master<->slave exchange runs with no wire. Selecting this pulls in
            e32p_uart.

endmenu
```

## components/e32p_mqtt/Kconfig
```kconfig
menu "e32p: mqtt"

    config E32P_MQTT_ENABLE
        bool "Enable e32p_mqtt (MQTT v3.1.1 client)"
        default n
        help
            MQTT client facade over ESP-IDF's esp-mqtt: client lifecycle,
            publish/subscribe, connection state, and a compact event callback.
            The MQTT topic-filter matching (+/# wildcards, $-topic rule) is a pure
            function and is unit-tested headless; the network path needs Wi-Fi (or
            another netif) and a broker. Does not select a transport — the
            application provides connectivity (e.g. e32p_wifi).

endmenu
```

## components/e32p_nvs/Kconfig
```kconfig
menu "e32p: nvs"

    config E32P_NVS_ENABLE
        bool "Enable e32p_nvs (NVS key-value store)"
        default n
        help
            Wrapper over the ESP-IDF NVS flash key-value store: idempotent init
            (auto-erases on version/space mismatch), a per-namespace handle for
            efficient grouped access, and one-shot read/write helpers.

endmenu
```

## components/e32p_obd2/Kconfig
```kconfig
menu "e32p: obd2"

    config E32P_OBD2_ENABLE
        bool "Enable e32p_obd2 (SAE J1979 / ISO 15765-4 OBD-II services)"
        depends on SOC_TWAI_SUPPORTED
        select E32P_ISOTP_ENABLE
        default n
        help
            OBD-II services over ISO-TP: current data (0x01), freeze frame
            (0x02), stored and pending trouble codes (0x03 / 0x07), clear
            (0x04), and vehicle information (0x09).

            The service layer is pure - one request in, one response out, with
            no clock and no bus - so every service is testable headless. Only
            the thin transport glue touches ISO-TP.

    config E32P_OBD2_MAX_DTC
        int "Diagnostic trouble codes the store holds"
        depends on E32P_OBD2_ENABLE
        range 1 32
        default 10
        help
            Each code costs 3 bytes of RAM and 5 characters in the NVS string
            that survives a reset. A real ECU holds far more; 10 is enough for
            a demo and keeps the store one short write.

endmenu
```

## components/e32p_ota/Kconfig
```kconfig
menu "e32p: ota"

    config E32P_OTA_ENABLE
        bool "Enable e32p_ota (over-the-air firmware update)"
        default n
        help
            Firmware update over esp_ota_ops + esp_https_ota: query the running
            slot / app version / image size, control rollback, stream an image
            into the next slot from any source, or pull one from an HTTP(S) URL.
            Requires an OTA-capable partition table (otadata + ota_0/ota_1) — the
            platform's default partitions.csv provides one. The query and rollback
            layer is unit-tested offline; the download path needs a network.

endmenu
```

## components/e32p_pcnt/Kconfig
```kconfig
menu "e32p: pcnt"

    config E32P_PCNT_ENABLE
        bool "Enable e32p_pcnt (pulse counter)"
        depends on SOC_PCNT_SUPPORTED
        default n
        help
            Facade over the ESP-IDF v5.x pulse counter: count rising/falling edges
            on a GPIO, with an optional io_loop_back test mode (feed the GPIO's own
            output back to its input, so gpio_set_level generates counts).

endmenu
```

## components/e32p_pm/Kconfig
```kconfig
menu "e32p: pm"

    config E32P_PM_ENABLE
        bool "Enable e32p_pm (low-power sleep + wake sources)"
        default n
        help
            Low-power facade over esp_sleep: configure wake sources (timer, ext0,
            ext1, GPIO, touch), enter light or deep sleep, and report the wake
            cause with a friendly enum. Adds argument validation and RTC-pin
            checks over the raw API. Light sleep returns and is unit-tested
            on-target; deep sleep resets the chip. No other e32p modules required.

endmenu
```
