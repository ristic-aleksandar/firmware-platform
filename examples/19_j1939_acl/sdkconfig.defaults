## examples/23_mqtt/main/Kconfig.projbuild
```kconfig
menu "23_mqtt example"

    config EXAMPLE_WIFI_SSID
        string "Wi-Fi SSID"
        default ""
        help
            Your Wi-Fi network name. Set this (and the password) with
            `idf.py menuconfig` — credentials are not hardcoded in source.

    config EXAMPLE_WIFI_PASSWORD
        string "Wi-Fi password"
        default ""
        help
            Wi-Fi passphrase. Leave empty for an open network.

    config EXAMPLE_BROKER_URI
        string "MQTT broker URI"
        default "mqtt://test.mosquitto.org:1883"
        help
            Broker to connect to, e.g. mqtt://host:1883. The default is a public
            test broker; use your own for anything real.

endmenu
```

## examples/26_ota_http/main/Kconfig.projbuild
```kconfig
menu "26_ota_http example"

    config EXAMPLE_WIFI_SSID
        string "Wi-Fi SSID"
        default ""
        help
            Your Wi-Fi network name (set via `idf.py menuconfig`, not in source).

    config EXAMPLE_WIFI_PASSWORD
        string "Wi-Fi password"
        default ""
        help
            Wi-Fi passphrase. Leave empty for an open network.

    config EXAMPLE_OTA_URL
        string "OTA firmware URL"
        default "http://192.168.0.41:8080/ota_http.bin"
        help
            HTTP(S) URL of the .bin to pull. For a local test, serve the build
            directory with `python -m http.server 8080` and point this at your
            PC's IP. https:// needs the app to provide TLS certificates.

endmenu
```

## examples/29_edge_gateway/main/Kconfig.projbuild
```kconfig
menu "29_edge_gateway"

    config GW_SOURCE_J1939
        bool "Read a real J1939/CAN bus (needs a transceiver)"
        default n
        help
            When set, the gateway reads live J1939 frames over e32p_twai +
            e32p_j1939 — this needs an SN65HVD230-class CAN transceiver wired to
            the pins below. When unset (the default), a built-in simulator
            produces J1939-shaped signals so the whole cloud / provisioning
            path can be demonstrated with no extra hardware. Flip this on once the
            transceiver is in hand.

    config GW_CAN_TX_GPIO
        int "CAN TX GPIO"
        default 5
        help
            TWAI (CAN) TX pin. Avoid the strapping pins (0, 2, 12, 15).

    config GW_CAN_RX_GPIO
        int "CAN RX GPIO"
        default 4
        help
            TWAI (CAN) RX pin.

    config GW_STATUS_LED_GPIO
        int "Status LED GPIO"
        default 2
        help
            Solid = cloud connected. The DevKit's onboard LED is GPIO2, so this
            needs no wiring by default.

    config GW_TM1637_CLK_GPIO
        int "TM1637 CLK GPIO (optional display)"
        default 18

    config GW_TM1637_DIO_GPIO
        int "TM1637 DIO GPIO (optional display)"
        default 19

    config GW_FALLBACK_WIFI_SSID
        string "Fallback Wi-Fi SSID (testing only)"
        default ""
        help
            Optional convenience for bench testing. If BLE provisioning has not
            stored a config yet AND this is non-empty, the gateway uses these
            build-time credentials so you can exercise the cloud path without a
            phone. Leave empty to force BLE provisioning. Nothing is hardcoded in
            source — these live in your local sdkconfig only.

    config GW_FALLBACK_WIFI_PASSWORD
        string "Fallback Wi-Fi password (testing only)"
        default ""

    config GW_FALLBACK_BROKER_URI
        string "Fallback MQTT broker URI (testing only)"
        default "mqtt://test.mosquitto.org:1883"
        help
            Used together with the fallback SSID above.

endmenu
```

## examples/30_j1939_ecu_sim/main/Kconfig.projbuild
```kconfig
menu "30_j1939_ecu_sim"

    config ECU_CAN_TX_GPIO
        int "CAN TX GPIO"
        default 4 if IDF_TARGET_ESP32S3
        default 21
        help
            TWAI (CAN) TX pin, wired to the transceiver's TXD. Defaults match the
            bench pin map per chip (WROOM 21, S3 4 — the S3 has no GPIO 22-25).
            Avoid the strapping pins.

    config ECU_CAN_RX_GPIO
        int "CAN RX GPIO"
        default 5 if IDF_TARGET_ESP32S3
        default 22
        help
            TWAI (CAN) RX pin, wired to the transceiver's RXD. Defaults match the
            bench pin map per chip (WROOM 22, S3 5).

endmenu
```

## examples/31_isotp_echo/main/Kconfig.projbuild
```kconfig
menu "31_isotp_echo"

    choice EX31_ROLE
        prompt "Node role"
        default EX31_ROLE_LOOPBACK
        help
            LOOPBACK runs both ends in one app over an in-process queue - one
            board, no transceiver. NODE_A and NODE_B are the two ends of a real
            CAN bus: flash A to one board and B to the other.

        config EX31_ROLE_LOOPBACK
            bool "Loopback - both engines in one app, no bus"
        config EX31_ROLE_NODE_A
            bool "Node A - tester: sends the payload, verifies the echo"
        config EX31_ROLE_NODE_B
            bool "Node B - ECU: reassembles and echoes"
    endchoice

    config EX31_PAYLOAD_LEN
        int "Payload length (bytes)"
        range 1 4095
        default 100
        help
            Bytes node A sends each round. 1..7 goes out as a single frame;
            anything longer exercises FF -> FC -> CF segmentation.

    config EX31_CAN_TX_GPIO
        int "CAN TX GPIO"
        default 4 if IDF_TARGET_ESP32S3
        default 21
        help
            TWAI (CAN) TX pin, wired to the transceiver's TXD. Defaults match the
            bench pin map per chip (WROOM 21, S3 4 - the S3 has no GPIO 22-25).

    config EX31_CAN_RX_GPIO
        int "CAN RX GPIO"
        default 5 if IDF_TARGET_ESP32S3
        default 22
        help
            TWAI (CAN) RX pin, wired to the transceiver's RXD (WROOM 22, S3 5).

endmenu
```

## examples/32_obd2_ecu/main/Kconfig.projbuild
```kconfig
menu "32_obd2_ecu"

    choice EX32_ROLE
        prompt "Node role"
        default EX32_ROLE_ECU
        help
            ECU answers a scan tool: live data, a VIN, and a trouble code once
            the simulated engine overheats. TESTER is the other board, asking
            the same questions a scan tool would and printing the answers.
            Flash ECU to one board and TESTER to the other, or run ECU alone and
            drive it from a PC over a CANable.

        config EX32_ROLE_ECU
            bool "ECU - answers OBD-II requests"
        config EX32_ROLE_TESTER
            bool "Tester - polls the ECU and prints decoded values"
    endchoice

    config EX32_ECU_ADDR
        int "ECU address"
        range 16 23
        default 16
        help
            16 (0x10) is the first OBD ECU: requests on 0x7E0, answers on 0x7E8
            in 11-bit builds, 0x18DA10F1 / 0x18DAF110 in 29-bit ones. Raise it to
            put several simulated ECUs on one bus.

    config EX32_POLL_MS
        int "Tester poll period (ms)"
        range 200 10000
        default 1000
        help
            How often the tester runs one round of requests.

    config EX32_CAN_TX_GPIO
        int "CAN TX GPIO"
        default 4 if IDF_TARGET_ESP32S3
        default 21
        help
            TWAI (CAN) TX pin, wired to the transceiver's TXD. Defaults match the
            bench pin map per chip (WROOM 21, S3 4 - the S3 has no GPIO 22-25).

    config EX32_CAN_RX_GPIO
        int "CAN RX GPIO"
        default 5 if IDF_TARGET_ESP32S3
        default 22
        help
            TWAI (CAN) RX pin, wired to the transceiver's RXD (WROOM 22, S3 5).

endmenu
```
